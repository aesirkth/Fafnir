## zephyr-firmware/example-application/build/Kconfig/Kconfig.modules
```kconfig
menu "example-application (C:/Users/alexm/Fafnir/zephyr-firmware/example-application)"
osource "C:/Users/alexm/Fafnir/zephyr-firmware/example-application/Kconfig"
config ZEPHYR_EXAMPLE_APPLICATION_MODULE
	bool
	default y
endmenu
menu "cmsis (C:/Users/alexm/Fafnir/zephyr-firmware/modules/hal/cmsis)"
osource "$(ZEPHYR_CMSIS_KCONFIG)"
config ZEPHYR_CMSIS_MODULE
	bool
	default y
endmenu
menu "cmsis_6 (C:/Users/alexm/Fafnir/zephyr-firmware/modules/hal/cmsis_6)"
osource "$(ZEPHYR_CMSIS_6_KCONFIG)"
config ZEPHYR_CMSIS_6_MODULE
	bool
	default y
endmenu
menu "hal_st (C:/Users/alexm/Fafnir/zephyr-firmware/modules/hal/st)"
osource "$(ZEPHYR_HAL_ST_KCONFIG)"
config ZEPHYR_HAL_ST_MODULE
	bool
	default y
endmenu
config ZEPHYR_HAL_STM32_MODULE
	bool
	default y

config ZEPHYR_HAL_STM32_MODULE_BLOBS
	bool
```

## zephyr-firmware/example-application/build/Kconfig/Kconfig.shield.defconfig
```kconfig
osource "C:/Users/alexm/Fafnir/zephyr-firmware/example-application/boards/shields/*/Kconfig.defconfig"
```

## zephyr-firmware/example-application/build/Kconfig/Kconfig.sysbuild.modules
```kconfig
config ZEPHYR_EXAMPLE_APPLICATION_MODULE
   bool
   default y
config ZEPHYR_CMSIS_MODULE
   bool
   default y
config ZEPHYR_CMSIS_6_MODULE
   bool
   default y
config ZEPHYR_HAL_ST_MODULE
   bool
   default y
config ZEPHYR_HAL_STM32_MODULE
   bool
   default y
```

## zephyr-firmware/example-application/build/Kconfig/arch/Kconfig
```kconfig
# Load Zephyr Arch Kconfig descriptions.
osource "C:/Users/alexm/Fafnir/zephyr-firmware/zephyr/arch/rx/Kconfig"
osource "C:/Users/alexm/Fafnir/zephyr-firmware/zephyr/arch/x86/Kconfig"
osource "C:/Users/alexm/Fafnir/zephyr-firmware/zephyr/arch/xtensa/Kconfig"
osource "C:/Users/alexm/Fafnir/zephyr-firmware/zephyr/arch/sparc/Kconfig"
osource "C:/Users/alexm/Fafnir/zephyr-firmware/zephyr/arch/riscv/Kconfig"
osource "C:/Users/alexm/Fafnir/zephyr-firmware/zephyr/arch/posix/Kconfig"
osource "C:/Users/alexm/Fafnir/zephyr-firmware/zephyr/arch/mips/Kconfig"
osource "C:/Users/alexm/Fafnir/zephyr-firmware/zephyr/arch/arm64/Kconfig"
osource "C:/Users/alexm/Fafnir/zephyr-firmware/zephyr/arch/arm/Kconfig"
osource "C:/Users/alexm/Fafnir/zephyr-firmware/zephyr/arch/arc/Kconfig"
```

## zephyr-firmware/example-application/build/Kconfig/boards/Kconfig
```kconfig
# Load Zephyr board Kconfig descriptions.
osource "C:/Users/alexm/Fafnir/zephyr-firmware/example-application/boards/vendor/fafnir/Kconfig"
```

## zephyr-firmware/example-application/build/Kconfig/boards/Kconfig.defconfig
```kconfig
# Load Zephyr board defconfig descriptions.
osource "C:/Users/alexm/Fafnir/zephyr-firmware/example-application/boards/vendor/fafnir/Kconfig.defconfig"
```

## zephyr-firmware/example-application/build/Kconfig/boards/Kconfig.fafnir
```kconfig
# Load board Kconfig descriptions.
osource "C:/Users/alexm/Fafnir/zephyr-firmware/example-application/boards/vendor/fafnir/Kconfig.fafnir"
```

## zephyr-firmware/example-application/build/Kconfig/soc/Kconfig
```kconfig
# Load Zephyr SoC Kconfig descriptions.
osource "C:/Users/alexm/Fafnir/zephyr-firmware/zephyr/soc/xlnx/zynqmp/Kconfig"
osource "C:/Users/alexm/Fafnir/zephyr-firmware/zephyr/soc/xlnx/zynq7000/Kconfig"
osource "C:/Users/alexm/Fafnir/zephyr-firmware/zephyr/soc/xlnx/versalnet/Kconfig"
osource "C:/Users/alexm/Fafnir/zephyr-firmware/zephyr/soc/xlnx/versal2/Kconfig"
osource "C:/Users/alexm/Fafnir/zephyr-firmware/zephyr/soc/xen/Kconfig"
osource "C:/Users/alexm/Fafnir/zephyr-firmware/zephyr/soc/wch/ch32v/Kconfig"
osource "C:/Users/alexm/Fafnir/zephyr-firmware/zephyr/soc/ti/simplelink/Kconfig"
osource "C:/Users/alexm/Fafnir/zephyr-firmware/zephyr/soc/ti/mspm0/Kconfig"
osource "C:/Users/alexm/Fafnir/zephyr-firmware/zephyr/soc/ti/lm3s6965/Kconfig"
osource "C:/Users/alexm/Fafnir/zephyr-firmware/zephyr/soc/ti/k3/Kconfig"
osource "C:/Users/alexm/Fafnir/zephyr-firmware/zephyr/soc/telink/tlsr/Kconfig"
osource "C:/Users/alexm/Fafnir/zephyr-firmware/zephyr/soc/starfive/jh71xx/Kconfig"
osource "C:/Users/alexm/Fafnir/zephyr-firmware/zephyr/soc/st/stm32/Kconfig"
osource "C:/Users/alexm/Fafnir/zephyr-firmware/zephyr/soc/snps/qemu_arc/Kconfig"
osource "C:/Users/alexm/Fafnir/zephyr-firmware/zephyr/soc/snps/nsim/arc_v/Kconfig"
osource "C:/Users/alexm/Fafnir/zephyr-firmware/zephyr/soc/snps/nsim/arc_classic/Kconfig"
osource "C:/Users/alexm/Fafnir/zephyr-firmware/zephyr/soc/snps/hsdk4xd/Kconfig"
osource "C:/Users/alexm/Fafnir/zephyr-firmware/zephyr/soc/snps/hsdk/Kconfig"
osource "C:/Users/alexm/Fafnir/zephyr-firmware/zephyr/soc/snps/emsk/Kconfig"
osource "C:/Users/alexm/Fafnir/zephyr-firmware/zephyr/soc/snps/emsdp/Kconfig"
osource "C:/Users/alexm/Fafnir/zephyr-firmware/zephyr/soc/snps/arc_iot/Kconfig"
osource "C:/Users/alexm/Fafnir/zephyr-firmware/zephyr/soc/silabs/Kconfig"
osource "C:/Users/alexm/Fafnir/zephyr-firmware/zephyr/soc/sifli/sf32/Kconfig"
osource "C:/Users/alexm/Fafnir/zephyr-firmware/zephyr/soc/sifive/sifive_freedom/Kconfig"
osource "C:/Users/alexm/Fafnir/zephyr-firmware/zephyr/soc/sensry/Kconfig"
osource "C:/Users/alexm/Fafnir/zephyr-firmware/zephyr/soc/rockchip/Kconfig"
osource "C:/Users/alexm/Fafnir/zephyr-firmware/zephyr/soc/renode/riscv_virtual/Kconfig"
osource "C:/Users/alexm/Fafnir/zephyr-firmware/zephyr/soc/renode/cortex_r8_virtual/Kconfig"
osource "C:/Users/alexm/Fafnir/zephyr-firmware/zephyr/soc/renesas/smartbond/Kconfig"
osource "C:/Users/alexm/Fafnir/zephyr-firmware/zephyr/soc/renesas/rz/Kconfig"
osource "C:/Users/alexm/Fafnir/zephyr-firmware/zephyr/soc/renesas/rx/Kconfig"
osource "C:/Users/alexm/Fafnir/zephyr-firmware/zephyr/soc/renesas/rcar/Kconfig"
osource "C:/Users/alexm/Fafnir/zephyr-firmware/zephyr/soc/renesas/ra/Kconfig"
osource "C:/Users/alexm/Fafnir/zephyr-firmware/zephyr/soc/realtek/ec/Kconfig"
osource "C:/Users/alexm/Fafnir/zephyr-firmware/zephyr/soc/raspberrypi/rpi_pico/Kconfig"
osource "C:/Users/alexm/Fafnir/zephyr-firmware/zephyr/soc/quicklogic/eos_s3/Kconfig"
osource "C:/Users/alexm/Fafnir/zephyr-firmware/zephyr/soc/qemu/virt_riscv/Kconfig"
osource "C:/Users/alexm/Fafnir/zephyr-firmware/zephyr/soc/qemu/malta/Kconfig"
osource "C:/Users/alexm/Fafnir/zephyr-firmware/zephyr/soc/openisa/rv32m1/Kconfig"
osource "C:/Users/alexm/Fafnir/zephyr-firmware/zephyr/soc/openhwgroup/cva6/Kconfig"
osource "C:/Users/alexm/Fafnir/zephyr-firmware/zephyr/soc/oct/osd32mp15x/Kconfig"
osource "C:/Users/alexm/Fafnir/zephyr-firmware/zephyr/soc/nxp/s32/Kconfig"
osource "C:/Users/alexm/Fafnir/zephyr-firmware/zephyr/soc/nxp/rw/Kconfig"
osource "C:/Users/alexm/Fafnir/zephyr-firmware/zephyr/soc/nxp/mcx/Kconfig"
osource "C:/Users/alexm/Fafnir/zephyr-firmware/zephyr/soc/nxp/lpc/Kconfig"
osource "C:/Users/alexm/Fafnir/zephyr-firmware/zephyr/soc/nxp/layerscape/Kconfig"
osource "C:/Users/alexm/Fafnir/zephyr-firmware/zephyr/soc/nxp/kinetis/Kconfig"
osource "C:/Users/alexm/Fafnir/zephyr-firmware/zephyr/soc/nxp/imxrt/Kconfig"
osource "C:/Users/alexm/Fafnir/zephyr-firmware/zephyr/soc/nxp/imx/Kconfig"
osource "C:/Users/alexm/Fafnir/zephyr-firmware/zephyr/soc/nuvoton/numicro/Kconfig"
osource "C:/Users/alexm/Fafnir/zephyr-firmware/zephyr/soc/nuvoton/numaker/Kconfig"
osource "C:/Users/alexm/Fafnir/zephyr-firmware/zephyr/soc/nuvoton/npcx/Kconfig"
osource "C:/Users/alexm/Fafnir/zephyr-firmware/zephyr/soc/nuvoton/npcm/Kconfig"
osource "C:/Users/alexm/Fafnir/zephyr-firmware/zephyr/soc/nordic/Kconfig"
osource "C:/Users/alexm/Fafnir/zephyr-firmware/zephyr/soc/neorv32/Kconfig"
osource "C:/Users/alexm/Fafnir/zephyr-firmware/zephyr/soc/native/inf_clock/Kconfig"
osource "C:/Users/alexm/Fafnir/zephyr-firmware/zephyr/soc/microchip/sam/Kconfig"
osource "C:/Users/alexm/Fafnir/zephyr-firmware/zephyr/soc/microchip/sam/sama7/Kconfig"
osource "C:/Users/alexm/Fafnir/zephyr-firmware/zephyr/soc/microchip/sam/sam_d5x_e5x/Kconfig"
osource "C:/Users/alexm/Fafnir/zephyr-firmware/zephyr/soc/microchip/pic32c/pic32cz_ca/Kconfig"
osource "C:/Users/alexm/Fafnir/zephyr-firmware/zephyr/soc/microchip/pic32c/pic32cx_sg/Kconfig"
osource "C:/Users/alexm/Fafnir/zephyr-firmware/zephyr/soc/microchip/pic32c/pic32cm_jh/Kconfig"
osource "C:/Users/alexm/Fafnir/zephyr-firmware/zephyr/soc/microchip/miv/Kconfig"
osource "C:/Users/alexm/Fafnir/zephyr-firmware/zephyr/soc/microchip/mec/Kconfig"
osource "C:/Users/alexm/Fafnir/zephyr-firmware/zephyr/soc/mediatek/mt8xxx/Kconfig"
osource "C:/Users/alexm/Fafnir/zephyr-firmware/zephyr/soc/lowrisc/opentitan/Kconfig"
osource "C:/Users/alexm/Fafnir/zephyr-firmware/zephyr/soc/litex/litex_vexriscv/Kconfig"
osource "C:/Users/alexm/Fafnir/zephyr-firmware/zephyr/soc/ite/ec/Kconfig"
osource "C:/Users/alexm/Fafnir/zephyr-firmware/zephyr/soc/intel/raptor_lake/Kconfig"
osource "C:/Users/alexm/Fafnir/zephyr-firmware/zephyr/soc/intel/panther_lake/Kconfig"
osource "C:/Users/alexm/Fafnir/zephyr-firmware/zephyr/soc/intel/lakemont/Kconfig"
osource "C:/Users/alexm/Fafnir/zephyr-firmware/zephyr/soc/intel/intel_socfpga_std/Kconfig"
osource "C:/Users/alexm/Fafnir/zephyr-firmware/zephyr/soc/intel/intel_socfpga/Kconfig"
osource "C:/Users/alexm/Fafnir/zephyr-firmware/zephyr/soc/intel/intel_niosv/Kconfig"
osource "C:/Users/alexm/Fafnir/zephyr-firmware/zephyr/soc/intel/intel_ish/Kconfig"
osource "C:/Users/alexm/Fafnir/zephyr-firmware/zephyr/soc/intel/intel_adsp/Kconfig"
osource "C:/Users/alexm/Fafnir/zephyr-firmware/zephyr/soc/intel/elkhart_lake/Kconfig"
osource "C:/Users/alexm/Fafnir/zephyr-firmware/zephyr/soc/intel/atom/Kconfig"
osource "C:/Users/alexm/Fafnir/zephyr-firmware/zephyr/soc/intel/apollo_lake/Kconfig"
osource "C:/Users/alexm/Fafnir/zephyr-firmware/zephyr/soc/intel/alder_lake/Kconfig"
osource "C:/Users/alexm/Fafnir/zephyr-firmware/zephyr/soc/infineon/edge/Kconfig"
osource "C:/Users/alexm/Fafnir/zephyr-firmware/zephyr/soc/infineon/cat3/Kconfig"
osource "C:/Users/alexm/Fafnir/zephyr-firmware/zephyr/soc/infineon/cat1c/Kconfig"
osource "C:/Users/alexm/Fafnir/zephyr-firmware/zephyr/soc/infineon/cat1b/Kconfig"
osource "C:/Users/alexm/Fafnir/zephyr-firmware/zephyr/soc/infineon/cat1a/Kconfig"
osource "C:/Users/alexm/Fafnir/zephyr-firmware/zephyr/soc/gd/gd32/Kconfig"
osource "C:/Users/alexm/Fafnir/zephyr-firmware/zephyr/soc/gaisler/leon3/Kconfig"
osource "C:/Users/alexm/Fafnir/zephyr-firmware/zephyr/soc/gaisler/gr716a/Kconfig"
osource "C:/Users/alexm/Fafnir/zephyr-firmware/zephyr/soc/espressif/Kconfig"
osource "C:/Users/alexm/Fafnir/zephyr-firmware/zephyr/soc/ene/kb1200/Kconfig"
osource "C:/Users/alexm/Fafnir/zephyr-firmware/zephyr/soc/ene/kb106x/Kconfig"
osource "C:/Users/alexm/Fafnir/zephyr-firmware/zephyr/soc/egis/Kconfig"
osource "C:/Users/alexm/Fafnir/zephyr-firmware/zephyr/soc/efinix/sapphire/Kconfig"
osource "C:/Users/alexm/Fafnir/zephyr-firmware/zephyr/soc/cdns/xtensa_sample_controller/Kconfig"
osource "C:/Users/alexm/Fafnir/zephyr-firmware/zephyr/soc/cdns/sample_controller32/Kconfig"
osource "C:/Users/alexm/Fafnir/zephyr-firmware/zephyr/soc/cdns/dc233c/Kconfig"
osource "C:/Users/alexm/Fafnir/zephyr-firmware/zephyr/soc/brcm/bcmvk/Kconfig"
osource "C:/Users/alexm/Fafnir/zephyr-firmware/zephyr/soc/brcm/bcm2712/Kconfig"
osource "C:/Users/alexm/Fafnir/zephyr-firmware/zephyr/soc/brcm/bcm2711/Kconfig"
osource "C:/Users/alexm/Fafnir/zephyr-firmware/zephyr/soc/bflb/Kconfig"
osource "C:/Users/alexm/Fafnir/zephyr-firmware/zephyr/soc/atmel/sam0/Kconfig"
osource "C:/Users/alexm/Fafnir/zephyr-firmware/zephyr/soc/atmel/sam/Kconfig"
osource "C:/Users/alexm/Fafnir/zephyr-firmware/zephyr/soc/aspeed/Kconfig"
osource "C:/Users/alexm/Fafnir/zephyr-firmware/zephyr/soc/arm/Kconfig"
osource "C:/Users/alexm/Fafnir/zephyr-firmware/zephyr/soc/arm/beetle/Kconfig"
osource "C:/Users/alexm/Fafnir/zephyr-firmware/zephyr/soc/antmicro/myra/Kconfig"
osource "C:/Users/alexm/Fafnir/zephyr-firmware/zephyr/soc/andestech/Kconfig"
osource "C:/Users/alexm/Fafnir/zephyr-firmware/zephyr/soc/amd/acp_6_0/Kconfig"
osource "C:/Users/alexm/Fafnir/zephyr-firmware/zephyr/soc/ambiq/Kconfig"
osource "C:/Users/alexm/Fafnir/zephyr-firmware/zephyr/soc/aesc/Kconfig"
osource "C:/Users/alexm/Fafnir/zephyr-firmware/zephyr/soc/adi/max32/Kconfig"
```

## zephyr-firmware/fafnir/boards/vendor/fafnir/board.yml
```yaml
board:
  name: fafnir
  full_name: fafnir propulsion engine controller
  vendor: aesir
  socs:
    - name: stm32u575xx
```
